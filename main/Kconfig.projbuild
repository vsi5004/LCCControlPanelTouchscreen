## main/Kconfig.projbuild
```kconfig
menu "LCC Turnout Panel Configuration"

    menu "Display Settings"
        config LCD_H_RES
            int "LCD Horizontal Resolution"
            default 800
            help
                Horizontal resolution of the LCD panel.

        config LCD_V_RES
            int "LCD Vertical Resolution"
            default 480
            help
                Vertical resolution of the LCD panel.

        config LCD_PIXEL_CLOCK_HZ
            int "LCD Pixel Clock (Hz)"
            default 16000000
            help
                Pixel clock frequency for the RGB LCD.

        config LCD_RGB_BOUNCE_BUFFER_HEIGHT
            int "RGB Bounce Buffer Height"
            default 480
            help
                Height of the bounce buffer in pixels. Width matches LCD.
                Use full screen height (480) for smooth animations without
                horizontal banding during tab transitions.
    endmenu

    menu "LVGL Settings"
        config LVGL_TASK_PRIORITY
            int "LVGL Task Priority"
            default 2
            range 1 25
            help
                Priority of the LVGL timer handler task.

        config LVGL_TASK_STACK_SIZE_KB
            int "LVGL Task Stack Size (KB)"
            default 8
            range 4 16
            help
                Stack size for the LVGL task in kilobytes.

        config LVGL_TICK_PERIOD_MS
            int "LVGL Tick Period (ms)"
            default 2
            range 1 10
            help
                Period of the LVGL tick timer in milliseconds.

        config LVGL_TASK_MAX_DELAY_MS
            int "LVGL Task Max Delay (ms)"
            default 500
            help
                Maximum delay between LVGL task iterations.

        config LVGL_TASK_MIN_DELAY_MS
            int "LVGL Task Min Delay (ms)"
            default 1
            help
                Minimum delay between LVGL task iterations.
    endmenu

    menu "I2C Settings"
        config I2C_MASTER_SCL_IO
            int "I2C Master SCL GPIO"
            default 9
            help
                GPIO number for I2C master clock.

        config I2C_MASTER_SDA_IO
            int "I2C Master SDA GPIO"
            default 8
            help
                GPIO number for I2C master data.

        config I2C_MASTER_FREQ_HZ
            int "I2C Master Frequency (Hz)"
            default 400000
            help
                I2C master clock frequency.
    endmenu

    menu "SD Card Settings"
        config SD_MOSI_GPIO
            int "SD Card MOSI GPIO"
            default 11

        config SD_MISO_GPIO
            int "SD Card MISO GPIO"
            default 13

        config SD_CLK_GPIO
            int "SD Card CLK GPIO"
            default 12

        config SD_MOUNT_POINT
            string "SD Card Mount Point"
            default "/sdcard"
    endmenu

    menu "CAN/TWAI Settings"
        config TWAI_TX_GPIO
            int "TWAI TX GPIO"
            default 15
            help
                GPIO number for CAN/TWAI transmit.

        config TWAI_RX_GPIO
            int "TWAI RX GPIO"
            default 16
            help
                GPIO number for CAN/TWAI receive.
    endmenu

    menu "LCC Settings"
        config LCC_NODE_ID_DEFAULT
            string "Default LCC Node ID"
            default "05.01.01.01.22.60"
            help
                Default Node ID if nodeid.txt is missing from SD card.

        config LCC_EVENT_RATE_LIMIT_MS
            int "LCC Event Rate Limit (ms)"
            default 20
            help
                Minimum interval between LCC events in milliseconds.
    endmenu

endmenu
```
